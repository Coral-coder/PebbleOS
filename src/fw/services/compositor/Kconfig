## src/fw/services/compositor/Kconfig
```kconfig
# SPDX-FileCopyrightText: 2026 Core Devices LLC
# SPDX-License-Identifier: Apache-2.0

config SERVICE_COMPOSITOR
    bool "Compositor"
    help
      UI compositor and window transitions.

if SERVICE_COMPOSITOR

config COMPOSITOR_PARTIAL_APP_UPDATES
    bool "Partial compositor updates from app dirty rect"
    default n
    help
      Composite and flush only the app framebuffer dirty region instead of
      clearing and copying the full screen on each app render. The panel still
      updates normally (required for transflective displays).

module = SERVICE_COMPOSITOR
module-str = Compositor
source "src/fw/Kconfig.template.log_level"

endif
```
